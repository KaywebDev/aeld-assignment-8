## base_external/package/aesd-assignments/Config.in
```kconfig
config BR2_PACKAGE_AESD_ASSIGNMENTS
	bool "aesd-assignments"
	depends on BR2_LINUX_KERNEL
	select BR2_PACKAGE_KMOD
	help
	  Includes the AESD applications and aesdchar kernel module.
```

## base_external/package/ldd/Config.in
```kconfig
config BR2_PACKAGE_LDD
	bool "ldd3 kernel modules"
	depends on BR2_LINUX_KERNEL
	select BR2_PACKAGE_KMOD
	help
	  Build and install the misc-modules and scull examples from the LDD3 fork.
```
